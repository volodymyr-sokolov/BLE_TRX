## CMakeLists.txt
```
cmake_minimum_required(VERSION 3.20.0)
find_package(Zephyr REQUIRED HINTS $ENV{ZEPHYR_BASE})
project(ble_trx)

target_sources(app PRIVATE
  src/main.c
  src/hostif.c
  src/adv.c
  src/rx.c
  src/cmd.c
  src/store.c
)
```

## prj.conf
```kconfig
# ble_trx: nRF52840 BLE packet generator and sniffer.
#
# No SoftDevice and no Bluetooth stack: RADIO is driven directly, which is
# what makes every on-air parameter controllable -- address, PDU type, channel
# (including data channels with any access address), interval, TX power,
# deliberately broken CRCs, raw PDUs, and the frequency deviation (BLE 1M vs
# Nordic's proprietary 1M mode) used to give the "twin" transmitter a
# different modulation index -- and what lets the same image receive on any
# channel / access address as a sniffer.

CONFIG_MAIN_STACK_SIZE=2048
CONFIG_SYSTEM_WORKQUEUE_STACK_SIZE=2048
CONFIG_HEAP_MEM_POOL_SIZE=2048
CONFIG_ISR_STACK_SIZE=2048

CONFIG_GPIO=y
CONFIG_SERIAL=y
CONFIG_CONSOLE=y
CONFIG_UART_CONSOLE=y
CONFIG_UART_LINE_CTRL=y

# USB CDC ACM is the command channel.
CONFIG_USB_DEVICE_STACK=y
CONFIG_USB_DEVICE_PRODUCT="nRF52840 BLE TX/RX"
CONFIG_USB_DEVICE_MANUFACTURER="ble_trx"
CONFIG_USB_DEVICE_VID=0x1915
CONFIG_USB_DEVICE_PID=0x520F
CONFIG_USB_CDC_ACM=y
# Sniffer output bursts; a larger ring rides out the host's USB polling gaps.
CONFIG_USB_CDC_ACM_RINGBUF_SIZE=16384
CONFIG_USB_DEVICE_INITIALIZE_AT_BOOT=n

CONFIG_LOG=y
CONFIG_LOG_MODE_MINIMAL=y
CONFIG_PRINTK=y
CONFIG_CBPRINTF_FP_SUPPORT=n

CONFIG_ENTROPY_GENERATOR=y

# Saved configuration ("save" / "boot on") in the settings_storage partition.
CONFIG_FLASH=y
CONFIG_FLASH_MAP=y
CONFIG_FLASH_PAGE_LAYOUT=y

CONFIG_REBOOT=y
CONFIG_CRC=y
CONFIG_ASSERT=y
CONFIG_THREAD_NAME=y

# Link the application at 0x26000 where the Adafruit nRF52 bootloader hands
# over.  Without this Zephyr links at 0x0 and the bootloader is erased.
CONFIG_USE_DT_CODE_PARTITION=y
```

## boards/nice_nano_v2.overlay
```dts
/*
 * The nice!nano v2 is an nRF52840 module with the same Adafruit bootloader and
 * the same 0x26000 application offset as the Feather, so it builds against the
 * Feather board target.  Only the LED differs: blue on P0.15 instead of red on
 * P1.15.
 */
/ {
	leds {
		led0: led_0 {
			gpios = <&gpio0 15 0>;
		};
	};
};
```

## src/main.c
```c
/*
 * ble_trx entry point.
 *
 * Brings up USB, loads any saved configuration, and -- like the sibling
 * adaptive-protocol firmware -- reboots into the bootloader on a fatal fault
 * so a board whose only link is USB can always be reflashed over the same
 * cable it failed on.
 */
#include "sim.h"

#include <zephyr/kernel.h>
#include <zephyr/device.h>
#include <zephyr/drivers/gpio.h>
#include <zephyr/usb/usb_device.h>
#include <zephyr/fatal.h>

static const struct gpio_dt_spec led =
	GPIO_DT_SPEC_GET_OR(DT_ALIAS(led0), gpios, {0});

void k_sys_fatal_error_handler(unsigned int reason, const struct arch_esf *esf)
{
	ARG_UNUSED(esf);
	hostif_printf("{\"ev\":\"fatal\",\"reason\":%u,\"thread\":\"%s\"}",
		      reason, k_thread_name_get(k_current_get()));
	k_busy_wait(50000);
	hostif_reboot_dfu();
	CODE_UNREACHABLE;
}

int main(void)
{
#if defined(CONFIG_USB_DEVICE_STACK)
	usb_enable(NULL);
#endif
	/* Let the host enumerate before the banner, or it lands in a port
	 * nobody has opened yet. */
	k_msleep(1500);

	if (led.port && device_is_ready(led.port)) {
		gpio_pin_configure_dt(&led, GPIO_OUTPUT_INACTIVE);
	}

	cfg_defaults(&cfg);
	bool loaded = store_load(&cfg) == 0;

	hostif_init(cmd_line);
	adv_init();
	rx_init();

	hostif_printf(
		"{\"ev\":\"boot\",\"fw\":\"ble_trx\",\"ver\":%u,\"board\":\"%s\","
		"\"loaded\":%d}",
		SIM_VERSION, CONFIG_BOARD, loaded);
	hostif_printf("type 'help' for commands, 'info' for the current configuration");

	if (cfg.autostart == AUTOSTART_TX) {
		adv_start(0);
		hostif_printf("{\"ev\":\"autostart\",\"mode\":\"tx\"}");
	} else if (cfg.autostart == AUTOSTART_RX) {
		rx_start();
		hostif_printf("{\"ev\":\"autostart\",\"mode\":\"rx\"}");
	}

	for (;;) {
		if (led.port && device_is_ready(led.port)) {
			/* Slow blink idle, fast while advertising, medium while
			 * receiving. */
			gpio_pin_toggle_dt(&led);
		}
		k_msleep(stats.running ? 120 : rxstats.running ? 300 : 600);
	}
	return 0;
}
```

## src/adv.c
```c
/*
 * RADIO set-up and the advertising (TX) scheduler.
 *
 * Each advertising event sends one PDU on every configured channel in order,
 * `gap_us` apart, then waits interval (+ advDelay).  A whole event is sent by
 * one persona, so the second ("twin") persona stands in for a separate radio
 * seen under the same address -- the case the sniffer's clustering has to
 * resolve -- rather than splitting single events.
 *
 * TX runs the RADIO in polled mode from a dedicated thread: a legacy
 * advertising PDU is at most 376 us on air (a raw 257-byte PDU ~2.1 ms), so an
 * interrupt state machine would buy nothing.  The receiver (rx.c) shares the
 * radio; `radio_lock` is held by whichever side is configuring or using it,
 * and starting one side stops the other.
 */
#include "sim.h"

#include <string.h>
#include <nrfx.h>
#include <zephyr/random/random.h>
#include <zephyr/drivers/clock_control.h>
#include <zephyr/drivers/clock_control/nrf_clock_control.h>

/* PCNF1.MAXLEN is an 8-bit field.  258 would overflow it to 2 (and corrupt
 * STATLEN), truncating every packet to two payload bytes -- the bug that made
 * only the first four bytes of each PDU decode.  A legacy advertising payload
 * never exceeds 37 bytes, and 255 is the field's maximum. */
#define RADIO_MAXLEN 255u

static uint8_t pdu[MAX_RAW + 5] __aligned(4);
static struct k_thread adv_thr;
static K_SEM_DEFINE(adv_wake, 0, 1);

volatile struct sim_stats stats;
K_MUTEX_DEFINE(radio_lock);

/* Advertising-channel centre frequencies; data channels follow the BLE map. */
uint32_t channel_mhz(uint8_t ch)
{
	if (ch == 37) {
		return 2402;
	}
	if (ch == 38) {
		return 2426;
	}
	if (ch == 39) {
		return 2480;
	}
	if (ch <= 10) {
		return 2404 + 2 * ch;              /* data channels 0..10  */
	}
	return 2428 + 2 * (ch - 11);              /* data channels 11..36 */
}

static uint8_t freq_reg(uint8_t ch)
{
	return (uint8_t)(channel_mhz(ch) - 2400);
}

const char *phy_name(uint8_t phy)
{
	return phy == PHY_NRF1M ? "nrf1m" : "ble1m";
}

void radio_set_channel(uint8_t ch)
{
	NRF_RADIO->FREQUENCY = freq_reg(ch);
	/* BLE whitening LFSR init is {1, ch5..ch0}: position 0 is a hard 1,
	 * which the nRF takes from DATAWHITEIV bit 6.  Writing the channel index
	 * alone leaves bit 6 clear, so the first ~4 bytes de-whiten correctly
	 * (they come from the channel bits) and everything after diverges once
	 * the wrong seed bit propagates -- the exact symptom seen on air. */
	NRF_RADIO->DATAWHITEIV = 0x40u | (ch & 0x3F);
}

void radio_set_access_address(uint32_t aa)
{
	NRF_RADIO->BASE0 = (aa << 8) & 0xFFFFFF00u;
	NRF_RADIO->PREFIX0 = (aa >> 24) & 0xFFu;
}

void radio_disable(void)
{
	NRF_RADIO->SHORTS = 0;
	if (NRF_RADIO->STATE != RADIO_STATE_STATE_Disabled) {
		NRF_RADIO->EVENTS_DISABLED = 0;
		NRF_RADIO->TASKS_DISABLE = 1;
		while (NRF_RADIO->EVENTS_DISABLED == 0) {
			/* a few microseconds */
		}
	}
	NRF_RADIO->EVENTS_DISABLED = 0;
}

/* The twin's lower deviation (Nordic proprietary 1M, ~170 kHz) gives it a
 * modulation index near 0.34 against BLE 1M's 0.5, so the two personas carry a
 * physically different modulation index -- the primary fingerprint feature. */
void radio_set_phy(uint8_t phy)
{
	NRF_RADIO->MODE = (phy == PHY_NRF1M)
		? (RADIO_MODE_MODE_Nrf_1Mbit << RADIO_MODE_MODE_Pos)
		: (RADIO_MODE_MODE_Ble_1Mbit << RADIO_MODE_MODE_Pos);
}

int adv_power_supported(int dbm)
{
	static const int8_t tbl[] = {8, 7, 6, 5, 4, 3, 2, 0, -4, -8, -12, -16, -20, -40};

	for (size_t i = 0; i < ARRAY_SIZE(tbl); i++) {
		if (dbm == tbl[i]) {
			return 1;
		}
	}
	return 0;
}

static void hfxo_start(void)
{
	/* The crystal, not the RC oscillator: carrier-offset fingerprinting is
	 * the whole point of the receiver, so the source must be crystal-clean
	 * rather than drifting tens of ppm with the internal RC. */
	const struct device *clk = DEVICE_DT_GET_ONE(nordic_nrf_clock);

	if (device_is_ready(clk)) {
		struct onoff_manager *mgr =
			z_nrf_clock_control_get_onoff(CLOCK_CONTROL_NRF_SUBSYS_HF);
		struct onoff_client cli;

		sys_notify_init_spinwait(&cli.notify);
		if (onoff_request(mgr, &cli) >= 0) {
			int res;

			while (sys_notify_fetch_result(&cli.notify, &res) != 0) {
				k_busy_wait(50);
			}
		}
	}
}

void adv_init(void)
{
	hfxo_start();

	NRF_RADIO->POWER = 0;
	NRF_RADIO->POWER = 1;

	/* Fast ramp-up; DTX centred so an idle carrier does not sit off-channel. */
	NRF_RADIO->MODECNF0 = (RADIO_MODECNF0_RU_Fast << RADIO_MODECNF0_RU_Pos) |
			      (RADIO_MODECNF0_DTX_Center << RADIO_MODECNF0_DTX_Pos);

	NRF_RADIO->TXADDRESS = 0;
	NRF_RADIO->RXADDRESSES = 1u;        /* logical address 0 = BASE0/PREFIX0.AP0 */
	NRF_RADIO->PCNF0 = (1u << RADIO_PCNF0_S0LEN_Pos) |
			   (8u << RADIO_PCNF0_LFLEN_Pos) |
			   (0u << RADIO_PCNF0_S1LEN_Pos);
	/* 3 base + 1 prefix = a 4-byte access address, little-endian payload,
	 * hardware whitening on.  Leaving PCNF1 at reset gives BALEN=0 (a
	 * 1-byte access address the sniffer can never correlate), WHITEEN=0 and
	 * MAXLEN=0 -- every symptom of "transmits but is never decoded". */
	NRF_RADIO->PCNF1 = ((uint32_t)RADIO_MAXLEN << RADIO_PCNF1_MAXLEN_Pos) |
			   (3u << RADIO_PCNF1_BALEN_Pos) |
			   (RADIO_PCNF1_ENDIAN_Little << RADIO_PCNF1_ENDIAN_Pos) |
			   (1u << RADIO_PCNF1_WHITEEN_Pos);
	NRF_RADIO->CRCCNF = (RADIO_CRCCNF_LEN_Three << RADIO_CRCCNF_LEN_Pos) |
			    (RADIO_CRCCNF_SKIPADDR_Skip << RADIO_CRCCNF_SKIPADDR_Pos);
	NRF_RADIO->CRCPOLY = 0x100065Bu;   /* BLE CRC-24 */
	NRF_RADIO->PACKETPTR = (uint32_t)pdu;
}

/* Raw mode: the operator's bytes, verbatim.  The radio sends the 2-byte
 * header and then as many payload bytes as the header's LENGTH field says, so
 * a LENGTH larger than the bytes supplied goes out zero-padded (the host tool
 * normally makes the two agree before it gets here). */
static uint16_t build_raw(void)
{
	memset(pdu, 0, sizeof(pdu));
	memcpy(pdu, cfg.raw, cfg.raw_len);
	return 2 + pdu[1];
}

/* Build one legacy advertising PDU into `pdu`.  header, length, then payload.
 * p->addr is already in on-air (LSB-first) order. */
static uint16_t build_pdu(const struct persona *p, uint16_t counter)
{
	uint8_t hdr = cfg.pdu_type & 0x0F;

	if (p->addr_random) {
		hdr |= 1u << 6;                /* TxAdd = random */
	}
	if (cfg.pdu_type == 0x01 && cfg.target_random) {
		hdr |= 1u << 7;                /* RxAdd for ADV_DIRECT_IND */
	}

	uint8_t *payload = &pdu[2];
	uint16_t n = 0;

	memcpy(&payload[n], p->addr, 6);
	n += 6;

	if (cfg.pdu_type == 0x01) {            /* ADV_DIRECT_IND: AdvA + TargetA */
		memcpy(&payload[n], cfg.target, 6);
		n += 6;
	} else {
		uint16_t dlen = cfg.adv_len;

		if (dlen > MAX_ADV_DATA) {
			dlen = MAX_ADV_DATA;
		}
		memcpy(&payload[n], cfg.adv_data, dlen);
		n += dlen;
		if (cfg.counter_on && n + 4 <= MAX_ADV_DATA) {
			payload[n++] = 3;      /* AD length */
			payload[n++] = 0xFF;   /* manufacturer-specific */
			payload[n++] = counter & 0xFF;
			payload[n++] = counter >> 8;
		}
	}

	pdu[0] = hdr;
	pdu[1] = (uint8_t)n;                   /* payload length */
	return n + 2;
}

static void send_on(uint8_t ch, bool corrupt)
{
	radio_set_channel(ch);
	NRF_RADIO->PACKETPTR = (uint32_t)pdu;   /* the receiver uses its own buffers */
	NRF_RADIO->CRCINIT = cfg.crc_init & 0xFFFFFF;
	if (corrupt) {
		/* Deliberately wrong seed -> the sniffer must see a CRC failure
		 * and colour the row, without the PDU being otherwise malformed. */
		NRF_RADIO->CRCINIT = (cfg.crc_init ^ 0x5A5A5Au) & 0xFFFFFF;
	}

	NRF_RADIO->EVENTS_END = 0;
	NRF_RADIO->EVENTS_DISABLED = 0;
	NRF_RADIO->SHORTS = RADIO_SHORTS_READY_START_Msk |
			    RADIO_SHORTS_END_DISABLE_Msk;
	NRF_RADIO->TASKS_TXEN = 1;
	while (NRF_RADIO->EVENTS_DISABLED == 0) {
		/* ~100-400 us; polling is simplest and nothing else runs here */
	}
}


static void adv_thread(void *a, void *b, void *c)
{
	ARG_UNUSED(a); ARG_UNUSED(b); ARG_UNUSED(c);

	for (;;) {
		if (!stats.running) {
			k_sem_take(&adv_wake, K_FOREVER);
			continue;
		}

		k_mutex_lock(&cfg_lock, K_FOREVER);

		bool use_twin = cfg.twin_on && cfg.twin_pct > 0 &&
				(sys_rand32_get() % 100) < cfg.twin_pct;
		const struct persona *p = use_twin ? &cfg.twin : &cfg.main;
		struct persona chosen = *p;

		if (use_twin && cfg.twin_same_addr) {
			memcpy(chosen.addr, cfg.main.addr, 6);
			chosen.addr_random = cfg.main.addr_random;
		}
		bool corrupt = cfg.crc_err_pct > 0 &&
			       (sys_rand32_get() % 100) < cfg.crc_err_pct;
		uint16_t counter = stats.counter;
		uint8_t nch = cfg.n_channels;
		uint8_t chans[MAX_CHANNELS];
		uint16_t gap = cfg.gap_us;
		uint16_t interval = cfg.interval_ms;
		bool delay = cfg.adv_delay;

		memcpy(chans, cfg.channels, nch);

		/* The receiver may have been started since this event was
		 * scheduled; it stops TX before it takes the radio, so re-check
		 * under the lock rather than transmit over it. */
		k_mutex_lock(&radio_lock, K_FOREVER);
		if (!stats.running) {
			k_mutex_unlock(&radio_lock);
			k_mutex_unlock(&cfg_lock);
			continue;
		}
		radio_set_access_address(cfg.access_address);
		radio_set_phy(chosen.phy);
		NRF_RADIO->TXPOWER = (uint8_t)chosen.power_dbm;
		if (cfg.raw_on && cfg.raw_len >= 2) {
			build_raw();
		} else {
			build_pdu(&chosen, counter);
		}

		k_mutex_unlock(&cfg_lock);

		for (uint8_t i = 0; i < nch; i++) {
			send_on(chans[i], corrupt);
			stats.packets++;
			if (i + 1 < nch && gap) {
				k_busy_wait(gap);
			}
		}
		k_mutex_unlock(&radio_lock);

		stats.events++;
		stats.counter++;
		if (use_twin) {
			stats.twin_events++;
		}
		if (corrupt) {
			stats.crc_errors++;
		}

		if (stats.remaining) {
			if (--stats.remaining == 0) {
				stats.running = false;
				hostif_printf("{\"ev\":\"done\",\"events\":%u}", stats.events);
				continue;
			}
		}

		uint32_t wait = interval;

		if (delay) {
			wait += sys_rand32_get() % 11;   /* spec advDelay 0-10 ms */
		}
		k_msleep(wait ? wait : 1);
	}
}

K_THREAD_STACK_DEFINE(adv_stack, 2048);

void adv_start(uint32_t count)
{
	rx_stop();                     /* one radio: TX and RX are exclusive */
	stats.remaining = count;       /* 0 = run until stopped */
	stats.running = true;
	k_sem_give(&adv_wake);
}

void adv_stop(void)
{
	stats.running = false;
	/* Wait out an event already on air, so the caller owns an idle radio. */
	k_mutex_lock(&radio_lock, K_FOREVER);
	k_mutex_unlock(&radio_lock);
}

static int adv_sys_init(void)
{
	k_thread_create(&adv_thr, adv_stack, K_THREAD_STACK_SIZEOF(adv_stack),
			adv_thread, NULL, NULL, NULL, 7, 0, K_NO_WAIT);
	k_thread_name_set(&adv_thr, "adv");
	return 0;
}
SYS_INIT(adv_sys_init, APPLICATION, 90);
```

## src/cmd.c
```c
/*
 * The command language.  One line per command, JSON acknowledgements out.
 *
 * Every on-air parameter is a command so the host-side test scripts can drive
 * a whole experiment over the wire.  `help` lists them; `info` dumps the
 * configuration the sniffer should expect to see.
 */
#include "sim.h"

#include <ctype.h>
#include <stdlib.h>
#include <string.h>
#include <zephyr/sys/reboot.h>

struct sim_cfg cfg;
K_MUTEX_DEFINE(cfg_lock);

void cfg_defaults(struct sim_cfg *c)
{
	memset(c, 0, sizeof(*c));
	c->magic = SIM_MAGIC;
	c->version = SIM_VERSION;
	c->size = sizeof(*c);

	/* A recognisable default identity and a Flags + Complete Local Name. */
	static const uint8_t addr[6] = {0x34, 0x12, 0xEF, 0xBE, 0xAD, 0xDE};
	memcpy(c->main.addr, addr, 6);
	c->main.addr_random = true;
	c->main.power_dbm = 0;
	c->main.phy = PHY_BLE1M;

	static const uint8_t twin[6] = {0x02, 0x00, 0x00, 0x00, 0x00, 0xC0};
	memcpy(c->twin.addr, twin, 6);
	c->twin.addr_random = true;
	c->twin.power_dbm = 0;
	c->twin.phy = PHY_NRF1M;      /* a different modulation index by default */
	c->twin_pct = 50;

	c->pdu_type = 0x00;           /* ADV_IND */
	static const uint8_t ad[] = {
		0x02, 0x01, 0x06,                               /* Flags */
		0x07, 0x09, 'b', 'l', 'e', 's', 'i', 'm',       /* Complete Local Name */
	};
	memcpy(c->adv_data, ad, sizeof(ad));
	c->adv_len = sizeof(ad);
	c->counter_on = true;

	c->channels[0] = 37;
	c->channels[1] = 38;
	c->channels[2] = 39;
	c->n_channels = 3;
	c->access_address = ADV_ACCESS_ADDRESS;
	c->crc_init = ADV_CRC_INIT;

	c->interval_ms = 100;
	c->adv_delay = true;
	c->gap_us = 1500;
	c->crc_err_pct = 0;
	c->autostart = AUTOSTART_OFF;

	c->raw_on = false;
	c->raw_len = 0;

	/* Receiver: advertising channel 37, good-CRC packets only. */
	c->rx.channels[0] = 37;
	c->rx.n_channels = 1;
	c->rx.phy = PHY_BLE1M;
	c->rx.access_address = ADV_ACCESS_ADDRESS;
	c->rx.crc_init = ADV_CRC_INIT;
	c->rx.dwell_ms = 0;
	c->rx.report_bad_crc = false;
}

/* ---- parsing helpers --------------------------------------------------- */

static char *next(char **p)
{
	char *s = *p;

	while (*s == ' ' || *s == '\t') {
		s++;
	}
	if (!*s) {
		*p = s;
		return NULL;
	}
	char *start = s;

	while (*s && *s != ' ' && *s != '\t') {
		s++;
	}
	if (*s) {
		*s++ = '\0';
	}
	*p = s;
	return start;
}

static bool parse_mac(const char *s, uint8_t out[6])
{
	/* Human order AA:BB:CC:DD:EE:FF -> on-air LSB-first out[0]=FF. */
	unsigned v[6];

	if (sscanf(s, "%x:%x:%x:%x:%x:%x", &v[0], &v[1], &v[2], &v[3], &v[4], &v[5]) != 6) {
		return false;
	}
	for (int i = 0; i < 6; i++) {
		if (v[i] > 0xFF) {
			return false;
		}
		out[i] = (uint8_t)v[5 - i];
	}
	return true;
}

static int hexval(char c)
{
	if (c >= '0' && c <= '9') {
		return c - '0';
	}
	c = (char)tolower((unsigned char)c);
	return (c >= 'a' && c <= 'f') ? c - 'a' + 10 : -1;
}

/* Hex bytes from the rest of a command line.  Whitespace (and ':' '-' ','
 * separators) anywhere is ignored, so "80 60 64 1c ae 7a", "80:60:64..." and
 * "8060641cae7a" are the same six bytes.  -1 on an odd digit count, a
 * non-hex character, or more than `max` bytes. */
static int parse_hex_bytes(const char *s, uint8_t *out, int max)
{
	int n = 0;
	int hi = -1;

	for (; *s; s++) {
		if (*s == ' ' || *s == '\t' || *s == ':' || *s == '-' || *s == ',') {
			continue;
		}
		int v = hexval(*s);

		if (v < 0) {
			return -1;
		}
		if (hi < 0) {
			hi = v;
			continue;
		}
		if (n >= max) {
			return -1;
		}
		out[n++] = (uint8_t)((hi << 4) | v);
		hi = -1;
	}
	return hi < 0 ? n : -1;
}

/* Everything left on the line (leading blanks skipped), or NULL. */
static char *rest(char **p)
{
	char *s = *p;

	while (*s == ' ' || *s == '\t') {
		s++;
	}
	*p = s + strlen(s);
	return *s ? s : NULL;
}

static const char *autostart_name(uint8_t a)
{
	return a == AUTOSTART_TX ? "on" : a == AUTOSTART_RX ? "rx" : "off";
}

static bool parse_channel_list(char **p, uint8_t *ch, uint8_t *count)
{
	uint8_t n = 0;
	char *v;

	while ((v = next(p))) {
		char *end;
		long idx = strtol(v, &end, 10);

		if (*end || idx < 0 || idx > 39 || n >= MAX_CHANNELS) {
			return false;
		}
		ch[n++] = (uint8_t)idx;
	}
	*count = n;
	return n > 0;
}

static void emit_mac(char *dst, const uint8_t a[6])
{
	snprintk(dst, 18, "%02X:%02X:%02X:%02X:%02X:%02X",
		 a[5], a[4], a[3], a[2], a[1], a[0]);
}

static void ack(const char *key, const char *val)
{
	hostif_printf("{\"ok\":\"%s\",\"%s\":\"%s\"}", key, key, val ? val : "");
}

static void err(const char *msg)
{
	hostif_printf("{\"err\":\"%s\"}", msg);
}

/* ---- info / help ------------------------------------------------------- */

static void hex_of(char *dst, const uint8_t *b, size_t n)
{
	static const char hex[] = "0123456789abcdef";

	for (size_t i = 0; i < n; i++) {
		dst[2 * i] = hex[b[i] >> 4];
		dst[2 * i + 1] = hex[b[i] & 0xF];
	}
	dst[2 * n] = '\0';
}

static void print_raw(void)
{
	char h[2 * MAX_RAW + 1];

	hex_of(h, cfg.raw, cfg.raw_len);
	hostif_printf("{\"ev\":\"raw\",\"on\":%d,\"len\":%u,\"pdu\":\"%s\"}",
		      cfg.raw_on, cfg.raw_len, h);
}

static void print_rx(void)
{
	char ch[MAX_CHANNELS * 26 + 1];
	size_t o = 0;

	for (uint8_t i = 0; i < cfg.rx.n_channels; i++) {
		if (cfg.rx.ch_aa[i]) {
			o += snprintk(&ch[o], sizeof(ch) - o, "%s\"%u:%08x:%06x\"",
				      i ? "," : "", cfg.rx.channels[i],
				      cfg.rx.ch_aa[i], cfg.rx.ch_crc[i]);
		} else {
			o += snprintk(&ch[o], sizeof(ch) - o, "%s%u", i ? "," : "",
				      cfg.rx.channels[i]);
		}
	}
	ch[o] = '\0';
	hostif_printf(
		"{\"ev\":\"rx\",\"running\":%d,\"channels\":[%s],\"phy\":\"%s\","
		"\"aa\":\"%08x\",\"crc_init\":\"%06x\",\"dwell_ms\":%u,\"bad_crc\":%d,"
		"\"packets\":%u,\"crc_bad\":%u,\"dropped\":%u,\"hops\":%u}",
		rxstats.running, ch, phy_name(cfg.rx.phy), cfg.rx.access_address,
		cfg.rx.crc_init, cfg.rx.dwell_ms, cfg.rx.report_bad_crc,
		rxstats.packets, rxstats.crc_bad, rxstats.dropped, rxstats.hops);
}

static void print_info(void)
{
	char a[18], t[18], w[18];

	k_mutex_lock(&cfg_lock, K_FOREVER);
	emit_mac(a, cfg.main.addr);
	emit_mac(t, cfg.twin.addr);
	emit_mac(w, cfg.target);
	hostif_printf(
		"{\"ev\":\"info\",\"running\":%d,\"addr\":\"%s\",\"random\":%d,"
		"\"phy\":\"%s\",\"power\":%d,\"pdu\":%u,\"adlen\":%u,\"counter\":%d}",
		stats.running, a, cfg.main.addr_random, phy_name(cfg.main.phy),
		cfg.main.power_dbm, cfg.pdu_type, cfg.adv_len, cfg.counter_on);
	hostif_printf(
		"{\"ev\":\"twin\",\"on\":%d,\"same_addr\":%d,\"pct\":%u,\"addr\":\"%s\","
		"\"phy\":\"%s\",\"power\":%d}",
		cfg.twin_on, cfg.twin_same_addr, cfg.twin_pct, t,
		phy_name(cfg.twin.phy), cfg.twin.power_dbm);
	hostif_printf(
		"{\"ev\":\"chan\",\"n\":%u,\"first\":%u,\"aa\":%u,\"crc_init\":%u,"
		"\"interval_ms\":%u,\"gap_us\":%u,\"crc_err_pct\":%u,\"target\":\"%s\"}",
		cfg.n_channels, cfg.n_channels ? cfg.channels[0] : 0,
		cfg.access_address, cfg.crc_init, cfg.interval_ms, cfg.gap_us,
		cfg.crc_err_pct, w);
	hostif_printf(
		"{\"ev\":\"stats\",\"events\":%u,\"packets\":%u,\"twin_events\":%u,"
		"\"crc_errors\":%u}",
		stats.events, stats.packets, stats.twin_events, stats.crc_errors);
	print_raw();
	print_rx();
	hostif_printf("{\"ev\":\"mode\",\"tx\":%d,\"rx\":%d,\"boot\":\"%s\","
		      "\"adv_delay\":%d,\"fw\":\"ble_trx\",\"ver\":%u,"
		      "\"out_dropped\":%u}",
		      stats.running, rxstats.running, autostart_name(cfg.autostart),
		      cfg.adv_delay, SIM_VERSION, hostif_dropped());
	k_mutex_unlock(&cfg_lock);
}

static void print_help(void)
{
	static const char *const lines[] = {
		"commands (one per line; values are decimal unless 0x-prefixed):",
		"  start [N]            advertise forever, or N events then stop",
		"  stop",
		"  addr AA:BB:..:FF     main advertiser address (human order)",
		"  type public|random   main address type",
		"  pdu adv_ind|adv_direct_ind|adv_nonconn_ind|adv_scan_ind",
		"  power <dBm>          8,7,6,5,4,3,2,0,-4,-8,-12,-16,-20,-40",
		"  phy ble1m|nrf1m      modulation (nrf1m has a lower mod index)",
		"  channels 37 38 39    advertising and/or data channel indices",
		"  aa 0xNNNNNNNN        access address (data channels)",
		"  crcinit 0xNNNNNN     CRC init / whitening-independent seed",
		"  interval <ms>        between advertising events",
		"  gap <us>             between channels within one event",
		"  data <hex>           raw AD structures, e.g. 020106... (spaces ok)",
		"  name <text>          shortcut: set a Complete Local Name AD",
		"  counter on|off       append a 16-bit event counter AD",
		"  crcerr <pct>         send this %% of packets with a bad CRC",
		"  twin on|off          enable the second transmitter personality",
		"  twin addr AA:..|same set the twin's address, or reuse main's",
		"  twin phy ble1m|nrf1m / twin power <dBm> / twin pct <0-100>",
		"  direct AA:BB:..:FF   TargetA for adv_direct_ind",
		"  advdelay on|off      random 0-10 ms advDelay added to each interval",
		"  raw <hex>            send this PDU (header+payload) verbatim; spaces ok",
		"  raw on|off           switch between the raw PDU and the built one",
		"  raw                  show the raw PDU",
		"rx (sniffer; starting RX stops TX and vice versa):",
		"  rx on|off            start / stop receiving (also: rx start|stop)",
		"  rx ch 37 [38 39]     channel, or a hop list (with rx dwell);",
		"                       ch:aa[:crcinit] gives one channel its own AA",
		"  rx dwell <ms>        time per channel when hopping (0 = no hop)",
		"  rx aa 0xNNNNNNNN     access address to receive on",
		"  rx crcinit 0xNNNNNN  CRC init to check against",
		"  rx phy ble1m|nrf1m   receiver modulation",
		"  rx crc ok|all        report good-CRC packets only, or all",
		"  rx adv               shortcut: aa 0x8E89BED6, crcinit 0x555555",
		"  rx info              receiver settings and counters",
		"  defaults             reset the whole configuration (not saved)",
		"  save | load | erase  persist / restore / clear the configuration",
		"  boot on|off|rx       at power-up: advertise / nothing / receive",
		"  info | help | dfu | reboot",
	};
	for (size_t i = 0; i < ARRAY_SIZE(lines); i++) {
		hostif_printf("%s", lines[i]);
	}
}

/* ---- the big switch ---------------------------------------------------- */

static bool set_phy_word(const char *v, uint8_t *out)
{
	if (!strcmp(v, "ble1m")) {
		*out = PHY_BLE1M;
	} else if (!strcmp(v, "nrf1m")) {
		*out = PHY_NRF1M;
	} else {
		return false;
	}
	return true;
}

/* "37 38 5:0x9E8B4B27:0x123456": channel[:aa[:crcinit]] tokens. */
static bool parse_rx_channels(char **p, struct rx_cfg *rx)
{
	uint8_t n = 0;
	char *v;

	while ((v = next(p))) {
		char *end;
		long idx = strtol(v, &end, 10);
		uint32_t aa = 0, crc = ADV_CRC_INIT;

		if (idx < 0 || idx > 39 || n >= MAX_CHANNELS) {
			return false;
		}
		if (*end == ':') {
			aa = (uint32_t)strtoul(end + 1, &end, 0);
			if (aa == 0) {
				return false;
			}
			if (*end == ':') {
				crc = (uint32_t)strtoul(end + 1, &end, 0) & 0xFFFFFF;
			}
		}
		if (*end) {
			return false;
		}
		rx->channels[n] = (uint8_t)idx;
		rx->ch_aa[n] = aa;
		rx->ch_crc[n] = crc;
		n++;
	}
	rx->n_channels = n;
	return n > 0;
}

static void cmd_raw(char **p)
{
	char *v = rest(p);
	uint8_t buf[MAX_RAW];

	if (!v) {
		k_mutex_lock(&cfg_lock, K_FOREVER);
		print_raw();
		k_mutex_unlock(&cfg_lock);
		return;
	}
	if (!strcmp(v, "on") || !strcmp(v, "off")) {
		if (!strcmp(v, "on") && cfg.raw_len < 2) {
			err("no raw PDU set; raw <hex>");
			return;
		}
		cfg.raw_on = !strcmp(v, "on");
		ack("raw", v);
		return;
	}

	int n = parse_hex_bytes(v, buf, MAX_RAW);

	if (n < 2) {
		err("raw <hex PDU: header(2) + payload, 2-257 bytes>");
		return;
	}
	k_mutex_lock(&cfg_lock, K_FOREVER);
	memset(cfg.raw, 0, sizeof(cfg.raw));
	memcpy(cfg.raw, buf, n);
	cfg.raw_len = (uint16_t)n;
	cfg.raw_on = true;
	k_mutex_unlock(&cfg_lock);
	/* The radio sends LENGTH (pdu[1]) payload bytes whatever was supplied;
	 * report both so a host can see a mismatch. */
	hostif_printf("{\"ok\":\"raw\",\"raw\":\"set\",\"len\":%d,"
		      "\"length_field\":%u,\"on_air\":%u}",
		      n, buf[1], 2u + buf[1]);
}

static void cmd_rx(char **p)
{
	char *sub = next(p);
	bool retune = true;

	if (!sub) {
		err("rx on|off|ch|dwell|aa|crcinit|phy|crc|adv|info");
		return;
	}
	if (!strcmp(sub, "on") || !strcmp(sub, "start")) {
		rx_start();
		ack("rx", "on");
		retune = false;
	} else if (!strcmp(sub, "off") || !strcmp(sub, "stop")) {
		rx_stop();
		ack("rx", "off");
		retune = false;
	} else if (!strcmp(sub, "info")) {
		k_mutex_lock(&cfg_lock, K_FOREVER);
		print_rx();
		k_mutex_unlock(&cfg_lock);
		retune = false;
	} else if (!strcmp(sub, "ch") || !strcmp(sub, "channels")) {
		struct rx_cfg tmp = cfg.rx;

		if (!parse_rx_channels(p, &tmp)) {
			err("rx ch: 1-8 of ch[:aa[:crcinit]], e.g. rx ch 37 5:0x9E8B4B27:0x123456");
			return;
		}
		k_mutex_lock(&cfg_lock, K_FOREVER);
		cfg.rx = tmp;
		k_mutex_unlock(&cfg_lock);
		ack("rx_ch", "set");
	} else if (!strcmp(sub, "dwell")) {
		char *v = next(p);

		if (!v) {
			err("rx dwell <ms>");
			return;
		}
		cfg.rx.dwell_ms = (uint16_t)strtoul(v, NULL, 0);
		ack("rx_dwell", v);
	} else if (!strcmp(sub, "aa")) {
		char *v = next(p);

		if (!v) {
			err("rx aa 0xNNNNNNNN");
			return;
		}
		cfg.rx.access_address = (uint32_t)strtoul(v, NULL, 0);
		ack("rx_aa", v);
	} else if (!strcmp(sub, "crcinit")) {
		char *v = next(p);

		if (!v) {
			err("rx crcinit 0xNNNNNN");
			return;
		}
		cfg.rx.crc_init = (uint32_t)strtoul(v, NULL, 0) & 0xFFFFFF;
		ack("rx_crcinit", v);
	} else if (!strcmp(sub, "phy")) {
		char *v = next(p);

		if (!v || !set_phy_word(v, &cfg.rx.phy)) {
			err("rx phy ble1m|nrf1m");
			return;
		}
		ack("rx_phy", v);
	} else if (!strcmp(sub, "crc")) {
		char *v = next(p);

		if (!v || (strcmp(v, "ok") && strcmp(v, "all"))) {
			err("rx crc ok|all");
			return;
		}
		cfg.rx.report_bad_crc = !strcmp(v, "all");
		ack("rx_crc", v);
	} else if (!strcmp(sub, "adv")) {
		cfg.rx.access_address = ADV_ACCESS_ADDRESS;
		cfg.rx.crc_init = ADV_CRC_INIT;
		ack("rx_adv", "ok");
	} else {
		err("unknown rx subcommand");
		return;
	}
	/* A setting changed while receiving takes effect immediately. */
	if (retune && rxstats.running) {
		rx_start();
	}
}

void cmd_line(char *line)
{
	char *p = line;
	char *c = next(&p);

	if (!c) {
		return;
	}

	if (!strcmp(c, "start")) {
		char *n = next(&p);

		adv_start(n ? (uint32_t)strtoul(n, NULL, 0) : 0);
		ack("start", n ? n : "0");
	} else if (!strcmp(c, "stop")) {
		adv_stop();
		ack("stop", "");
	} else if (!strcmp(c, "info")) {
		print_info();
	} else if (!strcmp(c, "help")) {
		print_help();
	} else if (!strcmp(c, "dfu")) {
		hostif_printf("{\"ev\":\"dfu\"}");
		hostif_reboot_dfu();
	} else if (!strcmp(c, "reboot")) {
		hostif_printf("{\"ev\":\"reboot\"}");
		k_msleep(50);
		sys_reboot(SYS_REBOOT_COLD);
	} else if (!strcmp(c, "addr")) {
		char *v = next(&p);
		uint8_t m[6];

		if (v && parse_mac(v, m)) {
			k_mutex_lock(&cfg_lock, K_FOREVER);
			memcpy(cfg.main.addr, m, 6);
			k_mutex_unlock(&cfg_lock);
			ack("addr", v);
		} else {
			err("addr AA:BB:CC:DD:EE:FF");
		}
	} else if (!strcmp(c, "type")) {
		char *v = next(&p);

		if (v && (!strcmp(v, "public") || !strcmp(v, "random"))) {
			cfg.main.addr_random = !strcmp(v, "random");
			ack("type", v);
		} else {
			err("type public|random");
		}
	} else if (!strcmp(c, "pdu")) {
		char *v = next(&p);

		if (!v) {
			err("pdu <type>");
		} else if (!strcmp(v, "adv_ind")) {
			cfg.pdu_type = 0x00; ack("pdu", v);
		} else if (!strcmp(v, "adv_direct_ind")) {
			cfg.pdu_type = 0x01; ack("pdu", v);
		} else if (!strcmp(v, "adv_nonconn_ind")) {
			cfg.pdu_type = 0x02; ack("pdu", v);
		} else if (!strcmp(v, "adv_scan_ind")) {
			cfg.pdu_type = 0x06; ack("pdu", v);
		} else {
			err("unknown pdu type");
		}
	} else if (!strcmp(c, "power")) {
		char *v = next(&p);
		int dbm = v ? atoi(v) : 99;

		if (v && adv_power_supported(dbm)) {
			cfg.main.power_dbm = (int8_t)dbm;
			ack("power", v);
		} else {
			err("unsupported power; see help");
		}
	} else if (!strcmp(c, "phy")) {
		char *v = next(&p);

		if (v && set_phy_word(v, (uint8_t *)&cfg.main.phy)) {
			ack("phy", v);
		} else {
			err("phy ble1m|nrf1m");
		}
	} else if (!strcmp(c, "channels")) {
		uint8_t ch[MAX_CHANNELS];
		uint8_t n = 0;

		if (!parse_channel_list(&p, ch, &n)) {
			err("channels: 1-8 indices 0-39, e.g. channels 37 38 39");
		} else {
			k_mutex_lock(&cfg_lock, K_FOREVER);
			memcpy(cfg.channels, ch, n);
			cfg.n_channels = n;
			k_mutex_unlock(&cfg_lock);
			ack("channels", "set");
		}
	} else if (!strcmp(c, "aa")) {
		char *v = next(&p);

		if (v) {
			cfg.access_address = (uint32_t)strtoul(v, NULL, 0);
			ack("aa", v);
		} else {
			err("aa 0xNNNNNNNN");
		}
	} else if (!strcmp(c, "crcinit")) {
		char *v = next(&p);

		if (v) {
			cfg.crc_init = (uint32_t)strtoul(v, NULL, 0) & 0xFFFFFF;
			ack("crcinit", v);
		} else {
			err("crcinit 0xNNNNNN");
		}
	} else if (!strcmp(c, "interval")) {
		char *v = next(&p);

		if (v) {
			cfg.interval_ms = (uint16_t)strtoul(v, NULL, 0);
			ack("interval", v);
		} else {
			err("interval <ms>");
		}
	} else if (!strcmp(c, "gap")) {
		char *v = next(&p);

		if (v) {
			cfg.gap_us = (uint16_t)strtoul(v, NULL, 0);
			ack("gap", v);
		} else {
			err("gap <us>");
		}
	} else if (!strcmp(c, "data")) {
		char *v = rest(&p);
		uint8_t buf[MAX_ADV_DATA];
		int n = v ? parse_hex_bytes(v, buf, MAX_ADV_DATA) : -1;

		if (n >= 0) {
			k_mutex_lock(&cfg_lock, K_FOREVER);
			memcpy(cfg.adv_data, buf, n);
			cfg.adv_len = (uint8_t)n;
			k_mutex_unlock(&cfg_lock);
			ack("data", "set");
		} else {
			err("data <even-length hex, <=31 bytes>");
		}
	} else if (!strcmp(c, "name")) {
		char *v = next(&p);
		size_t ln = v ? strlen(v) : 0;

		if (v && ln <= MAX_ADV_DATA - 5) {
			k_mutex_lock(&cfg_lock, K_FOREVER);
			cfg.adv_data[0] = 0x02;
			cfg.adv_data[1] = 0x01;
			cfg.adv_data[2] = 0x06;
			cfg.adv_data[3] = (uint8_t)(ln + 1);
			cfg.adv_data[4] = 0x09;
			memcpy(&cfg.adv_data[5], v, ln);
			cfg.adv_len = (uint8_t)(5 + ln);
			k_mutex_unlock(&cfg_lock);
			ack("name", v);
		} else {
			err("name too long");
		}
	} else if (!strcmp(c, "counter")) {
		char *v = next(&p);

		cfg.counter_on = v && !strcmp(v, "on");
		ack("counter", cfg.counter_on ? "on" : "off");
	} else if (!strcmp(c, "crcerr")) {
		char *v = next(&p);
		int pct = v ? atoi(v) : -1;

		if (pct >= 0 && pct <= 100) {
			cfg.crc_err_pct = (uint8_t)pct;
			ack("crcerr", v);
		} else {
			err("crcerr 0-100");
		}
	} else if (!strcmp(c, "direct")) {
		char *v = next(&p);
		uint8_t m[6];

		if (v && parse_mac(v, m)) {
			memcpy(cfg.target, m, 6);
			ack("direct", v);
		} else {
			err("direct AA:BB:CC:DD:EE:FF");
		}
	} else if (!strcmp(c, "twin")) {
		char *sub = next(&p);

		if (!sub) {
			err("twin on|off|addr|same|phy|power|pct");
		} else if (!strcmp(sub, "on")) {
			cfg.twin_on = true; ack("twin", "on");
		} else if (!strcmp(sub, "off")) {
			cfg.twin_on = false; ack("twin", "off");
		} else if (!strcmp(sub, "same")) {
			cfg.twin_same_addr = true; ack("twin", "same addr");
		} else if (!strcmp(sub, "addr")) {
			char *v = next(&p);
			uint8_t m[6];

			if (v && parse_mac(v, m)) {
				memcpy(cfg.twin.addr, m, 6);
				cfg.twin_same_addr = false;
				ack("twin_addr", v);
			} else {
				err("twin addr AA:BB:CC:DD:EE:FF");
			}
		} else if (!strcmp(sub, "phy")) {
			char *v = next(&p);

			if (v && set_phy_word(v, (uint8_t *)&cfg.twin.phy)) {
				ack("twin_phy", v);
			} else {
				err("twin phy ble1m|nrf1m");
			}
		} else if (!strcmp(sub, "power")) {
			char *v = next(&p);
			int dbm = v ? atoi(v) : 99;

			if (v && adv_power_supported(dbm)) {
				cfg.twin.power_dbm = (int8_t)dbm;
				ack("twin_power", v);
			} else {
				err("unsupported power; see help");
			}
		} else if (!strcmp(sub, "pct")) {
			char *v = next(&p);
			int pct = v ? atoi(v) : -1;

			if (pct >= 0 && pct <= 100) {
				cfg.twin_pct = (uint8_t)pct;
				ack("twin_pct", v);
			} else {
				err("twin pct 0-100");
			}
		} else {
			err("unknown twin subcommand");
		}
	} else if (!strcmp(c, "save")) {
		int rc = store_save(&cfg);

		if (rc == 0) {
			ack("save", "ok");
		} else {
			err("save failed");
		}
	} else if (!strcmp(c, "load")) {
		struct sim_cfg tmp;

		if (store_load(&tmp) == 0) {
			k_mutex_lock(&cfg_lock, K_FOREVER);
			cfg = tmp;
			k_mutex_unlock(&cfg_lock);
			ack("load", "ok");
		} else {
			err("no saved configuration");
		}
	} else if (!strcmp(c, "erase")) {
		store_erase();
		ack("erase", "ok");
	} else if (!strcmp(c, "boot")) {
		char *v = next(&p);

		if (v && !strcmp(v, "on")) {
			cfg.autostart = AUTOSTART_TX;
		} else if (v && !strcmp(v, "rx")) {
			cfg.autostart = AUTOSTART_RX;
		} else if (v && !strcmp(v, "off")) {
			cfg.autostart = AUTOSTART_OFF;
		} else {
			err("boot on|off|rx");
			return;
		}
		ack("boot", autostart_name(cfg.autostart));
	} else if (!strcmp(c, "advdelay")) {
		char *v = next(&p);

		if (v && (!strcmp(v, "on") || !strcmp(v, "off"))) {
			cfg.adv_delay = !strcmp(v, "on");
			ack("advdelay", v);
		} else {
			err("advdelay on|off");
		}
	} else if (!strcmp(c, "defaults")) {
		adv_stop();
		rx_stop();
		k_mutex_lock(&cfg_lock, K_FOREVER);
		cfg_defaults(&cfg);
		k_mutex_unlock(&cfg_lock);
		ack("defaults", "ok");
	} else if (!strcmp(c, "raw")) {
		cmd_raw(&p);
	} else if (!strcmp(c, "rx")) {
		cmd_rx(&p);
	} else {
		err("unknown command; type help");
	}
}
```

## src/hostif.c
```c
/*
 * USB CDC line interface: queued output, line-assembled input, and DFU entry.
 *
 * Output goes through a queue drained by its own thread so that a host that is
 * not reading -- or not even connected -- can never stall the advertising
 * scheduler: a full queue drops the line and counts it instead of blocking.
 */
#include "sim.h"

#include <stdarg.h>
#include <stdio.h>
#include <string.h>
#include <zephyr/device.h>
#include <zephyr/drivers/uart.h>
#include <zephyr/sys/reboot.h>
#include <hal/nrf_power.h>

/* A received 257-byte PDU is 514 hex characters plus ~130 of JSON around it. */
#define LINE_MAX_OUT 704
/* `raw` with a 257-byte PDU, even typed with a space between every byte. */
#define LINE_MAX_IN 800

struct out_line {
	char s[LINE_MAX_OUT];
};

K_MSGQ_DEFINE(outq, sizeof(struct out_line), 32, 4);

static const struct device *uart;
static void (*line_cb)(char *line);
static atomic_t dropped;

/*
 * Reboot into the Adafruit nRF52 bootloader's serial DFU mode.  These boards
 * have no SWD probe and no mass-storage volume; GPREGRET magic (or a physical
 * double tap of RESET) is the only way back into the bootloader, so the
 * application has to offer it or the board can only be reflashed by hand.
 */
#define DFU_MAGIC_SERIAL_ONLY_RESET 0x4Eu

void hostif_reboot_dfu(void)
{
	k_busy_wait(30000); /* let the last line reach the host */
	nrf_power_gpregret_set(NRF_POWER, 0, DFU_MAGIC_SERIAL_ONLY_RESET);
	NVIC_SystemReset();
}

void hostif_printf(const char *fmt, ...)
{
	struct out_line l;
	va_list ap;

	va_start(ap, fmt);
	int n = vsnprintk(l.s, sizeof(l.s) - 2, fmt, ap);
	va_end(ap);
	if (n < 0) {
		return;
	}
	if (n > (int)sizeof(l.s) - 3) {
		n = sizeof(l.s) - 3;
	}
	l.s[n] = '\r';
	l.s[n + 1] = '\n';
	if (n + 2 < (int)sizeof(l.s)) {
		l.s[n + 2] = '\0';
	}
	if (k_msgq_put(&outq, &l, K_NO_WAIT) != 0) {
		atomic_inc(&dropped);
	}
}

uint32_t hostif_out_free(void)
{
	return k_msgq_num_free_get(&outq);
}

uint32_t hostif_dropped(void)
{
	return (uint32_t)atomic_get(&dropped);
}

static void tx_thread(void *a, void *b, void *c)
{
	struct out_line l;

	ARG_UNUSED(a); ARG_UNUSED(b); ARG_UNUSED(c);
	for (;;) {
		k_msgq_get(&outq, &l, K_FOREVER);
		for (size_t i = 0; i < sizeof(l.s) && l.s[i]; i++) {
			uart_poll_out(uart, l.s[i]);
		}
	}
}

static void rx_thread(void *a, void *b, void *c)
{
	static char buf[LINE_MAX_IN];
	size_t n = 0;
	bool seen_normal = false;
	uint32_t poll = 0;

	ARG_UNUSED(a); ARG_UNUSED(b); ARG_UNUSED(c);
	for (;;) {
		unsigned char ch;
		bool idle = true;

		/* Flashing tools open the port at 1200 baud to request DFU. */
		if ((poll++ & 0x1F) == 0) {
			uint32_t baud = 0;

			if (uart_line_ctrl_get(uart, UART_LINE_CTRL_BAUD_RATE, &baud) == 0) {
				if (baud == 1200 && seen_normal) {
					hostif_reboot_dfu();
				} else if (baud > 1200) {
					seen_normal = true;
				}
			}
		}

		while (uart_poll_in(uart, &ch) == 0) {
			idle = false;
			if (ch == '\r' || ch == '\n') {
				if (n) {
					buf[n] = '\0';
					line_cb(buf);
					n = 0;
				}
			} else if (ch == 0x08 || ch == 0x7F) {
				if (n) {
					n--;
				}
			} else if (n < sizeof(buf) - 1) {
				buf[n++] = (char)ch;
			}
		}
		if (idle) {
			k_msleep(3);
		}
	}
}

K_THREAD_STACK_DEFINE(tx_stack, 1024);
K_THREAD_STACK_DEFINE(rx_stack, 3072);
static struct k_thread tx_thr, rx_thr;

void hostif_init(void (*on_line)(char *line))
{
	uart = DEVICE_DT_GET(DT_CHOSEN(zephyr_console));
	line_cb = on_line;
	k_thread_create(&tx_thr, tx_stack, K_THREAD_STACK_SIZEOF(tx_stack),
			tx_thread, NULL, NULL, NULL, 9, 0, K_NO_WAIT);
	k_thread_name_set(&tx_thr, "host_tx");
	k_thread_create(&rx_thr, rx_stack, K_THREAD_STACK_SIZEOF(rx_stack),
			rx_thread, NULL, NULL, NULL, 10, 0, K_NO_WAIT);
	k_thread_name_set(&rx_thr, "host_rx");
}
```

## src/rx.c
```c
/*
 * The receiver: a BLE link-layer sniffer on one channel or a hop list.
 *
 * The RADIO runs interrupt-driven.  On every END the ISR copies the PDU, its
 * CRC verdict, the received CRC, RSSI and an address-match timestamp into a
 * queue and restarts reception straight away; a reporter thread turns the
 * queue into one JSON line per packet on the USB port.  Nothing on the host
 * side can stall the radio: if the host does not keep up, the queue fills and
 * the ISR counts the packets it had to drop (`rx info` reports them).
 *
 * Timestamps: RADIO EVENTS_ADDRESS (the end of the access address) captures
 * TIMER0, free-running at 1 MHz, through the pre-programmed PPI channel 26, so
 * the time is taken in hardware at the same point of every packet and is not
 * blurred by interrupt latency.  The 32-bit count is widened to 64 bits here.
 */
#include "sim.h"

#include <string.h>
#include <nrfx.h>
#include <zephyr/irq.h>

#define RX_QUEUE_LEN 24
/* Fixed PPI channel 26: RADIO->EVENTS_ADDRESS -> TIMER0->TASKS_CAPTURE[1]. */
#define PPI_CH_ADDRESS_TO_TIMER0 26

struct rx_pkt {
	uint32_t t_us;          /* TIMER0 at the access-address match */
	uint32_t crc;           /* RXCRC: CRC as received */
	uint8_t ch;
	uint8_t rssi;           /* RSSISAMPLE: -dBm */
	uint8_t crc_ok;
	uint8_t pad;
	uint32_t aa;            /* access address the packet was received on */
	uint8_t pdu[MAX_RAW];   /* header + payload; length is pdu[1] + 2 */
};

K_MSGQ_DEFINE(rxq, sizeof(struct rx_pkt), RX_QUEUE_LEN, 4);
static K_SEM_DEFINE(rx_wake, 0, 1);

volatile struct rx_stats rxstats;

static uint8_t rxbuf[MAX_RAW + 3] __aligned(4);
static struct rx_cfg active;     /* snapshot taken by rx_start() */
static volatile uint8_t cur_ch;
static volatile uint32_t cur_aa;
static uint8_t hop_idx;
static bool report_bad;

/* 64-bit microsecond clock from the 32-bit TIMER0. */
static uint32_t t_last;
static uint64_t t_high;

static uint64_t widen(uint32_t t32)
{
	/* Reports can arrive slightly out of order with the idle-time clock
	 * reads (a packet queued just before a read is reported after it), so
	 * only a step of more than half the range counts as a wrap; a small step
	 * backwards is an older sample of the same epoch. */
	uint32_t back = t_last - t32;
	uint32_t fwd = t32 - t_last;

	if (t32 < t_last) {
		if (back > 0x80000000u) {               /* wrapped */
			t_high += 1ull << 32;
			t_last = t32;
		}
		return t_high | t32;
	}
	if (fwd > 0x80000000u && t_high) {      /* late sample from before a wrap */
		return (t_high - (1ull << 32)) | t32;
	}
	t_last = t32;
	return t_high | t32;
}

static uint32_t timer_now(void)
{
	NRF_TIMER0->TASKS_CAPTURE[2] = 1;
	return NRF_TIMER0->CC[2];
}

static void radio_isr(const void *arg)
{
	ARG_UNUSED(arg);

	if (!NRF_RADIO->EVENTS_END) {
		return;
	}
	NRF_RADIO->EVENTS_END = 0;

	bool ok = NRF_RADIO->CRCSTATUS != 0;

	if (!ok) {
		rxstats.crc_bad++;
	}
	if (ok || report_bad) {
		struct rx_pkt p;
		uint16_t len = 2u + rxbuf[1];

		p.t_us = NRF_TIMER0->CC[1];
		p.crc = NRF_RADIO->RXCRC & 0xFFFFFF;
		p.ch = cur_ch;
		p.rssi = (uint8_t)NRF_RADIO->RSSISAMPLE;
		p.crc_ok = ok;
		p.pad = 0;
		p.aa = cur_aa;
		memcpy(p.pdu, rxbuf, len);
		if (k_msgq_put(&rxq, &p, K_NO_WAIT) != 0) {
			rxstats.dropped++;
		}
	}
	/* Back to listening: RXIDLE -> RX, the same buffer (already copied). */
	NRF_RADIO->TASKS_START = 1;
}

/* Called with radio_lock held and the radio disabled. */
static void listen_on(uint8_t idx)
{
	uint8_t ch = active.channels[idx];
	uint32_t aa = active.ch_aa[idx] ? active.ch_aa[idx] : active.access_address;
	uint32_t crc = active.ch_aa[idx] ? active.ch_crc[idx] : active.crc_init;

	cur_ch = ch;
	cur_aa = aa;
	radio_set_access_address(aa);
	NRF_RADIO->CRCINIT = crc & 0xFFFFFF;
	radio_set_channel(ch);
	NRF_RADIO->EVENTS_END = 0;
	NRF_RADIO->EVENTS_READY = 0;
	NRF_RADIO->SHORTS = RADIO_SHORTS_READY_START_Msk |
			    RADIO_SHORTS_ADDRESS_RSSISTART_Msk;
	NRF_RADIO->INTENSET = RADIO_INTENSET_END_Msk;
	NRF_RADIO->TASKS_RXEN = 1;
}

void rx_start(void)
{
	adv_stop();                    /* one radio: TX and RX are exclusive */
	rx_stop();

	k_mutex_lock(&cfg_lock, K_FOREVER);
	active = cfg.rx;
	k_mutex_unlock(&cfg_lock);
	if (active.n_channels == 0) {
		active.n_channels = 1;
		active.channels[0] = 37;
		active.ch_aa[0] = 0;
	}
	report_bad = active.report_bad_crc;
	hop_idx = 0;

	k_mutex_lock(&radio_lock, K_FOREVER);
	radio_disable();
	k_msgq_purge(&rxq);
	radio_set_phy(active.phy);
	NRF_RADIO->PACKETPTR = (uint32_t)rxbuf;
	rxstats.running = true;
	listen_on(0);
	k_mutex_unlock(&radio_lock);

	k_sem_give(&rx_wake);
}

void rx_stop(void)
{
	if (!rxstats.running) {
		return;
	}
	k_mutex_lock(&radio_lock, K_FOREVER);
	rxstats.running = false;
	NRF_RADIO->INTENCLR = 0xFFFFFFFFu;
	radio_disable();
	NVIC_ClearPendingIRQ(RADIO_IRQn);
	NRF_RADIO->EVENTS_END = 0;
	k_mutex_unlock(&radio_lock);
}

/* Move to the next channel of the hop list. */
static void hop(void)
{
	k_mutex_lock(&radio_lock, K_FOREVER);
	if (rxstats.running) {
		NRF_RADIO->INTENCLR = RADIO_INTENCLR_END_Msk;
		radio_disable();
		hop_idx = (hop_idx + 1) % active.n_channels;
		listen_on(hop_idx);
		rxstats.hops++;
	}
	k_mutex_unlock(&radio_lock);
}

static void report(const struct rx_pkt *p)
{
	static const char hex[] = "0123456789abcdef";
	/* "aa" is the access address the packet was received on: the receiver
	 * only accepts packets that match it. */
	char s[2 * MAX_RAW + 1];
	uint16_t len = 2u + p->pdu[1];
	uint64_t t = widen(p->t_us);

	for (uint16_t i = 0; i < len; i++) {
		s[2 * i] = hex[p->pdu[i] >> 4];
		s[2 * i + 1] = hex[p->pdu[i] & 0xF];
	}
	s[2 * len] = '\0';

	rxstats.packets++;
	hostif_printf(
		"{\"ev\":\"pkt\",\"n\":%u,\"t\":%u.%06u,\"ch\":%u,\"rssi\":-%u,"
		"\"crc_ok\":%u,\"aa\":\"%08x\",\"pdu\":\"%s\",\"crc\":\"%06x\"}",
		rxstats.packets, (uint32_t)(t / 1000000u), (uint32_t)(t % 1000000u),
		p->ch, p->rssi, p->crc_ok, p->aa, s, p->crc);
}

static void rx_thread(void *a, void *b, void *c)
{
	ARG_UNUSED(a); ARG_UNUSED(b); ARG_UNUSED(c);
	int64_t next_hop = 0;

	for (;;) {
		if (!rxstats.running) {
			k_sem_take(&rx_wake, K_FOREVER);
			next_hop = k_uptime_get() + active.dwell_ms;
			continue;
		}

		bool hopping = active.n_channels > 1 && active.dwell_ms > 0;
		int64_t now = k_uptime_get();
		k_timeout_t wait = K_MSEC(200);

		if (hopping) {
			if (now >= next_hop) {
				hop();
				next_hop = now + active.dwell_ms;
			}
			wait = K_MSEC(next_hop - now > 0 ? next_hop - now : 1);
		}

		/* The output queue is the host's back-pressure: hold the packet
		 * here (and let the radio queue absorb, then count, the excess)
		 * rather than have the line dropped after it was formatted. */
		if (hostif_out_free() < 2) {
			k_msleep(1);
			continue;
		}

		struct rx_pkt p;

		if (k_msgq_get(&rxq, &p, wait) == 0) {
			report(&p);
		} else {
			/* Idle: keep the 64-bit clock correct across TIMER0 wraps
			 * (71 minutes) even when nothing is being received. */
			widen(timer_now());
		}
	}
}

K_THREAD_STACK_DEFINE(sniff_stack, 3072);
static struct k_thread sniff_thr;

void rx_init(void)
{
	NRF_TIMER0->TASKS_STOP = 1;
	NRF_TIMER0->MODE = TIMER_MODE_MODE_Timer;
	NRF_TIMER0->BITMODE = TIMER_BITMODE_BITMODE_32Bit;
	NRF_TIMER0->PRESCALER = 4;                 /* 16 MHz / 2^4 = 1 MHz */
	NRF_TIMER0->TASKS_CLEAR = 1;
	NRF_TIMER0->TASKS_START = 1;
	NRF_PPI->CHENSET = 1u << PPI_CH_ADDRESS_TO_TIMER0;

	IRQ_CONNECT(RADIO_IRQn, 1, radio_isr, NULL, 0);
	irq_enable(RADIO_IRQn);

	/* Lower priority than the USB writer (9): it must drain what this
	 * thread produces, or the output queue would only ever fill. */
	k_thread_create(&sniff_thr, sniff_stack, K_THREAD_STACK_SIZEOF(sniff_stack),
			rx_thread, NULL, NULL, NULL, 11, 0, K_NO_WAIT);
	k_thread_name_set(&sniff_thr, "sniff");
}
```

## src/store.c
```c
/*
 * Persist the configuration to the settings_storage flash partition.
 *
 * One fixed-size record at the start of the partition, CRC-32 protected.  No
 * settings subsystem and no wear levelling: the record is rewritten only when
 * the operator types `save`, which is rare, and a single erase/write of one
 * page is the whole operation.
 */
#include "sim.h"

#include <string.h>
#include <zephyr/storage/flash_map.h>
#include <zephyr/sys/crc.h>

#define STORE_PARTITION settings_storage
#define STORE_ID FIXED_PARTITION_ID(STORE_PARTITION)

static uint32_t record_crc(const struct sim_cfg *c)
{
	/* Everything except the trailing crc32 field. */
	return crc32_ieee((const uint8_t *)c, offsetof(struct sim_cfg, crc32));
}

int store_save(const struct sim_cfg *src)
{
	const struct flash_area *fa;
	struct sim_cfg rec;
	int rc;

	k_mutex_lock(&cfg_lock, K_FOREVER);
	rec = *src;
	k_mutex_unlock(&cfg_lock);
	rec.magic = SIM_MAGIC;
	rec.version = SIM_VERSION;
	rec.size = sizeof(rec);
	rec.crc32 = record_crc(&rec);

	rc = flash_area_open(STORE_ID, &fa);
	if (rc) {
		return rc;
	}
	/* Erase to a page boundary, then write the fixed-size record. */
	size_t esize = fa->fa_size;

	if (esize > 0x1000) {
		esize = 0x1000;        /* one 4 KB page is plenty */
	}
	rc = flash_area_erase(fa, 0, esize);
	if (rc == 0) {
		rc = flash_area_write(fa, 0, &rec, sizeof(rec));
	}
	flash_area_close(fa);
	return rc;
}

int store_load(struct sim_cfg *dst)
{
	const struct flash_area *fa;
	struct sim_cfg rec;
	int rc;

	rc = flash_area_open(STORE_ID, &fa);
	if (rc) {
		return rc;
	}
	rc = flash_area_read(fa, 0, &rec, sizeof(rec));
	flash_area_close(fa);
	if (rc) {
		return rc;
	}
	if (rec.magic != SIM_MAGIC || rec.version != SIM_VERSION ||
	    rec.size != sizeof(rec) || rec.crc32 != record_crc(&rec)) {
		return -ENOENT;
	}
	*dst = rec;
	return 0;
}

int store_erase(void)
{
	const struct flash_area *fa;
	int rc = flash_area_open(STORE_ID, &fa);

	if (rc) {
		return rc;
	}
	size_t esize = fa->fa_size > 0x1000 ? 0x1000 : fa->fa_size;

	rc = flash_area_erase(fa, 0, esize);
	flash_area_close(fa);
	return rc;
}
```
